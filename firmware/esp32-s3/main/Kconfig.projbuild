## firmware/esp32-s3/main/Kconfig.projbuild
```kconfig
menu "Simulator Joystick to FlySky"

config SIMJOY_PPM_GPIO
    int "PPM output GPIO"
    range 0 48
    default 4

config SIMJOY_PROTOCOL_UART
    int "Desktop protocol UART number"
    range 0 2
    default 1

config SIMJOY_PROTOCOL_TX_GPIO
    int "Desktop protocol UART TX GPIO"
    range 0 48
    default 17

config SIMJOY_PROTOCOL_RX_GPIO
    int "Desktop protocol UART RX GPIO"
    range 0 48
    default 18

config SIMJOY_PROTOCOL_BAUD
    int "Desktop protocol baud rate"
    default 115200

config SIMJOY_USB_TASK_CORE
    int "USB task core (-1 for no affinity)"
    range -1 1
    default 0

endmenu
```

## firmware/esp32-s3/sdkconfig.defaults
```kconfig
CONFIG_IDF_TARGET="esp32s3"
CONFIG_FREERTOS_HZ=1000
CONFIG_LOG_DEFAULT_LEVEL_INFO=y
CONFIG_COMPILER_OPTIMIZATION_PERF=y
CONFIG_ESP_MAIN_TASK_STACK_SIZE=6144
CONFIG_PARTITION_TABLE_SINGLE_APP_LARGE=y
```
